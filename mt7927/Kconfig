## mt7927/Kconfig
```kconfig
# SPDX-License-Identifier: BSD-3-Clause-Clear
config MT7927_COMMON
	tristate
	select MT792x_LIB
	select WANT_DEV_COREDUMP

config MT7927E
	tristate "MediaTek MT7927E (PCIe) support"
	select MT7927_COMMON
	depends on MAC80211
	depends on PCI
	help
	  This adds support for MT7927-based wireless PCIe devices,
	  which support operation at 6GHz, 5GHz, and 2.4GHz IEEE 802.11be
	  2x2:2SS 4096-QAM, 160MHz channels.

	  To compile this driver as a module, choose M here.
```
